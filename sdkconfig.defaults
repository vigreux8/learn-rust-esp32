## sdkconfig.defaults
```kconfig
# Rust often needs a bit of an extra main task stack size compared to C (the default is 3K)
CONFIG_ESP_MAIN_TASK_STACK_SIZE=8000

# Use this to set FreeRTOS kernel tick frequency to 1000 Hz (100 Hz by default).
# This allows to use 1 ms granularity for thread sleeps (10 ms by default).
#CONFIG_FREERTOS_HZ=1000

# Workaround for https://github.com/espressif/esp-idf/issues/7631
#CONFIG_MBEDTLS_CERTIFICATE_BUNDLE=n
#CONFIG_MBEDTLS_CERTIFICATE_BUNDLE_DEFAULT_FULL=n

# Active le support WebSocket côté serveur HTTP ESP-IDF.
CONFIG_HTTPD_WS_SUPPORT=y

# Les navigateurs desktop envoient souvent de gros headers HTTP.
CONFIG_HTTPD_MAX_REQ_HDR_LEN=1024

# Active le composant mDNS et l'annonce sur l'interface AP (mode hotspot ESP32).
CONFIG_MDNS_ENABLED=y
CONFIG_MDNS_PREDEF_NETIF_AP=y
CONFIG_MDNS_PREDEF_NETIF_STA=n
```
